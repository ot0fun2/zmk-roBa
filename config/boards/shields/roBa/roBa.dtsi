/ {
    chosen {
        zmk,kscan = &kscan0;
        zmk,matrix-transform = &default_transform;
    };

    default_transform: keymap_transform_0 {
        compatible = "zmk,matrix-transform";
        rows = <4>;
        columns = <11>;

        map = <
            0 1 2 3 4   6 7 8 9 10
            11 12 13 14 15   17 18 19 20 21
            22 23 24 25 26   28 29 30 31 32
            33 34 35 36 37   39 40 41 42 43
        >;
    };
};
